## config/boards/shields/forty/Kconfig.defconfig
```kconfig
if SHIELD_FORTY

config ZMK_KEYBOARD_NAME
    default "Forty"

config BT_DEVICE_NAME
	default ZMK_KEYBOARD_NAME


CONFIG_BT=y
CONFIG_ZMK_BLE=y
CONFIG_ZMK_BLE_EXPERIMENTAL_FEATURES=y
CONFIG_CLOCK_CONTROL_NRF_K32SRC_RC=y
CONFIG_BT_CTLR_PHY_2M=n
CONFIG_BT_CTLR_TX_PWR_PLUS_8=y

endif
```
